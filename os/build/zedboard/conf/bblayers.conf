## os/build/zedboard/conf/bblayers.conf
```bitbake
# POKY_BBLAYERS_CONF_VERSION is increased each time build/conf/bblayers.conf
# changes incompatibly
POKY_BBLAYERS_CONF_VERSION = "2"

BBPATH = "${TOPDIR}"
BBFILES ?= ""

ROOTDIR = "${TOPDIR}/../.."

BBLAYERS ?= " \
    ${ROOTDIR}/poky/meta \
    ${ROOTDIR}/poky/meta-poky \
    ${ROOTDIR}/poky/meta-yocto-bsp \
    ${ROOTDIR}/meta-openembedded/meta-oe \
    ${ROOTDIR}/meta-openembedded/meta-python \
    ${ROOTDIR}/meta-openembedded/meta-networking \
    ${ROOTDIR}/meta-xilinx/meta-xilinx-bsp \
    ${ROOTDIR}/meta-redpitaya \
    ${ROOTDIR}/meta-iris \
    ${ROOTDIR}/meta-misc \
    ${ROOTDIR}/meta-eseo \
    "
```

## os/meta-redpitaya/conf/machine/redpitaya.conf
```bitbake
SOC_VARIANT ?= "7z"

require conf/machine/include/tune-zynq.inc
require conf/machine/include/machine-xilinx-overrides.inc
require conf/machine/include/machine-xilinx-default.inc
require conf/machine/include/machine-xilinx-board.inc

UBOOT_MACHINE = "zynq_zed_config"
SPL_BINARY = "spl/boot.bin"

EXTRA_IMAGEDEPENDS += " \
		u-boot-zynq-uenv \
		virtual/boot-bin \
		"

SERIAL_CONSOLE = "115200 ttyPS0"

KERNEL_DEVICETREE = "zynq-redpitaya.dtb"

IMAGE_BOOT_FILES += "boot.bin uEnv.txt ${KERNEL_IMAGETYPE}-zynq-redpitaya.dtb"
```
